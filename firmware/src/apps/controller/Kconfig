## firmware/src/apps/controller/Kconfig
```kconfig
menu "Controller Module Configuration"

    config CONTROLLER_UART_RX_TASK_STACK_SIZE
        int "UART RX task stack size"
        range 1024 16384
        default 3072
        help
            Defines stack size for UART task.

    config CONTROLLER_UART_RX_TASK_PRIORITY
        int "UART RX task priority"
        range 1 10
        default 10
        help
            Defines task priority for the data reception UART task. 
            Should be of higher priority than the process task.

        config CONTROLLER_UART_PROCESS_STACK_SIZE
            int "Controller module task stack size"
            range 1024 16384
            default 4096
            help
                Defines stack size for the data processing UART task.

        config CONTROLLER_UART_PROCESS_TASK_PRIORITY
        int "UART PROCESS task priority"
        range 1 10
        default 9
        help
            Defines the task priority for the data processing UART task.

    config CONTROLLER_FREQUENCY
        int "Controller Tick Timer frequency"
        range 1 1000
        default 100
        help
            Defines the frequency at which the controller will "update" and send data to the plant.

    config CONTROLLER_DEBUG_LOG_ENABLED
        bool "Plant debug log flag"
        default n
        help
            If true, enables ESP logging with verbosity DEBUG.
    
endmenu
```

## firmware/src/drivers/adc_read/Kconfig
```kconfig
menu "Plant Module Configuration"

    config ADC_READ_STACK_SIZE
        int "ADC READ stack size"
        range 1024 16384
        default 4096
        help
            Defines stack size for ADC task.

    config ADC_READ_TASK_PRIORITY
        int "ADC READ task priority"
        range 1 10
        default 10
        help
            Defines task priority for the data ADC READ task.

    config ADC_READ_DEBUG_LOG_ENABLED
        bool "ADC READ debug log flag"
        default n
        help
            If true, enables ESP logging with verbosity DEBUG.
    

endmenu
```

## src/apps/plant/Kconfig
```kconfig
menu "Plant Module Configuration"

    config PLANT_UART_RX_TASK_STACK_SIZE
        int "UART RX stack size"
        range 1024 16384
        default 3072
        help
            Defines stack size for UART task.

    config PLANT_UART_RX_TASK_PRIORITY
        int "UART RX task priority"
        range 1 10
        default 10
        help
            Defines task priority for the data reception UART task. 
            Should be of higher priority than the main PLANT task.

    config PLANT_UART_PROCESS_STACK_SIZE
        int "Plant module task stack size"
        range 1024 16384
        default 4096
        help
            Defines stack size for the plant module task.

    config PLANT_UART_PROCESS_TASK_PRIORITY
        int "Plant module task priority"
        range 1 10
        default 9
        help
            Defines task priority for the plant module task.
    

endmenu
```

## src/main/Kconfig
```kconfig
menu "Main Configuration"

    config PLANT_MODULE_ENABLE
        bool "Enable Plant Module | Disable Controller Module"
        default y
        help
            Enable the Plant module, which simulates the plant dynamics and communicates with the controller via UART.
            If disabled, the controller module will be included in the build.
    
    config UART_PORT_NUM
        int "UART port number"
        range 0 2
        default 2
        help
            UART communication port number used for communication with the controller.
            By default, logging is done on UART0, whilst UART1 is reserved for SPI interfacing.

    config UART_BAUD_RATE
        int "UART communication speed"
        range 1200 115200
        default 115200
        help
            UART communication speed.

    config UART_RXD_PIN
        int "UART RXD pin number"
        range 0 30
        default 16
        help
            GPIO number for UART RX pin.

    config UART_TXD_PIN
        int "UART TXD pin number"
        range 0 30
        default 17
        help
            GPIO number for UART TX pin.

    config UART_BUF_SIZE
        int "UART buffer size"
        range 128 4096
        default 1024
        help
            Defines buffer size for UART.

    config UART_EVENT_QUEUE_SIZE
        int "UART event queue size"
        range 1 40
        default 20
        help
            Defines the size of the UART event queue.

endmenu
```
